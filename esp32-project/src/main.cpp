/**
 *
 * @file main.cpp
 * Link: https://wiki.seeedstudio.com/XIAO_ESP32C3_Getting_Started/
 *
 */

#include <Arduino.h>
#include <SPI.h>
#include <Wire.h>
#include <Adafruit_GFX.h>
#include <cstring>
#include <string.h>
#include <ArduinoJson.h>
#include "Adafruit_SH1106.hpp"

#include <Adafruit_NeoPixel.h>
#include <Fonts/FreeSans9pt7b.h>
#include <MFRC522.h>
#include <WiFi.h>
#include <PubSubClient.h>

#include "ButtonGroup.h"

ButtonGroup buttons(A0, A1);

#define PIN_LED_DATA_IN (D3)

#define PIN_OLED_SDA (D4)
#define PIN_OLED_SCL (D5)

#define PIN_RESET D2 // SPI Reset Pin
#define PIN_SS D6    // SPI Slave Select Pin

// How many NeoPixels are attached to the Arduino?
#define LED_COUNT 1

#define LOGO_WIDTH 128
#define LOGO_HEIGHT 64

const unsigned char thm_logo[] PROGMEM = {
    // 'thm_white, 120x28px
    0x00, 0x00, 0x00, 0x00, 0x00, 0x00, 0x00, 0x00, 0x00, 0x00, 0x00, 0x00, 0x00, 0x00, 0x00, 0x00,
    0x00, 0x00, 0x00, 0x00, 0x00, 0x00, 0x00, 0x00, 0x00, 0x00, 0x00, 0x00, 0x00, 0x00, 0x00, 0x00,
    0x00, 0x00, 0x00, 0x00, 0x00, 0x00, 0x00, 0x00, 0x00, 0x00, 0x00, 0x00, 0x00, 0x00, 0x00, 0x00,
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    0x00, 0x00, 0x00, 0x00, 0x00, 0x00, 0x00, 0x00, 0x00, 0x00, 0x00, 0x00, 0x00, 0x00, 0x00, 0x00};

// Declare our NeoPixel strip object:
Adafruit_NeoPixel strip(LED_COUNT, PIN_LED_DATA_IN, NEO_RGB + NEO_KHZ800);
// Argument 1 = Number of pixels in NeoPixel strip
// Argument 2 = Arduino pin number (most are valid)
// Argument 3 = Pixel type flags, add together as needed:
//   NEO_KHZ800  800 KHz bitstream (most NeoPixel products w/WS2812 LEDs)
//   NEO_KHZ400  400 KHz (classic 'v1' (not v2) FLORA pixels, WS2811 drivers)
//   NEO_GRB     Pixels are wired for GRB bitstream (most NeoPixel products)
//   NEO_RGB     Pixels are wired for RGB bitstream (v1 FLORA pixels, not v2)
//   NEO_RGBW    Pixels are wired for RGBW bitstream (NeoPixel RGBW products)

#define SCREEN_WIDTH 128 // OLED display width, in pixels
#define SCREEN_HEIGHT 64 // OLED display height, in pixels

// Declaration for an SSD1306 display connected to I2C (SDA, SCL pins)
// The pins for I2C are defined by the Wire-library.
// On an arduino UNO:       A4(SDA), A5(SCL)
// On an arduino MEGA 2560: 20(SDA), 21(SCL)
// On an arduino LEONARDO:   2(SDA),  3(SCL), ...
#define OLED_RESET -1                // Reset pin # (or -1 if sharing Arduino reset pin)
#define SCREEN_ADDRESS 0x3C          ///< See datasheet for Address; 0x3D for 128x64, 0x3C for 128x32
Adafruit_SH1106 display(OLED_RESET); // settings for 1306 (SCREEN_WIDTH, SCREEN_HEIGHT, &Wire, OLED_RESET);

#define DEBOUNCE_DELAY 250

// RFID
MFRC522 mfrc522(PIN_SS, PIN_RESET);
String rfid = "";

// MAC Address
uint8_t baseMac[6];

const char *text_colors[] = {"RED", "YELLOW", "GREEN", "BLUE", "ALL_WHITE", "NO_COLOR"};

// WiFi
const char *ssid = "testwlan";     // Enter your WiFi name
const char *password = "test1234"; // Enter WiFi password

// MQTT Broker
const char *mqtt_broker = "broker.emqx.io";
//const char *topic = "emqx/esp32";
const char *mqtt_username = "emqx";
const char *mqtt_password = "public";
const int mqtt_port = 1883;
//topic
const char* topic = "simon/game/#";


// PubSubClient
WiFiClient espClient;
PubSubClient client(espClient);

void read_mac();
void init_leds();
void init_oled();
void init_gpios();
void init_game_data();
void print_game_data();
void show_color_sequence(const char *color);
void add_new_color_to_sequence();
void print_game_data_serial();
void show_animation_correct();
void show_animation_correct();
void show_animation_wrong();
void show_thm_logo_oled(void);
void show_boot_sequence();
void check_and_set_best_score();
void callBack(char *topic, byte* payload, unsigned int length);
void colorsTest();
void setup()

{
  Serial.begin(9600);
  while (!Serial)
    ; // Wait until Serial is ready (comment out in standalone mode)
  buttons.set_thresholds(300, 700, 900);
  SPI.begin();
  mfrc522.PCD_Init();
  mfrc522.PCD_DumpVersionToSerial();

  /*WiFi.begin(ssid, password);
  while (WiFi.status() != WL_CONNECTED)


  {
    delay(500);
    Serial.println("Connecting to WiFi..");
  }
  Serial.println("Connected to the WiFi network");*/

  init_oled();
  init_leds();

  show_boot_sequence();

  show_thm_logo_oled();
  //colorsTest();
}

void loop()
{


}

void show_boot_sequence()
{
  uint8_t max_brightness = 20;
  uint16_t delay_time = 2000;
  uint8_t loops = 3;

  for (uint8_t i = 0; i < loops; i++)
  {
    for (uint8_t brightness = 0; brightness < max_brightness; brightness++)
    {
      strip.setBrightness(brightness);
      strip.setPixelColor(0, 255, 255, 255);
      strip.setPixelColor(1, 255, 255, 255);
      strip.setPixelColor(2, 255, 255, 255);
      strip.setPixelColor(3, 255, 255, 255);
      strip.show();
      delay(delay_time / max_brightness / loops / 2);
    }
    for (uint8_t brightness = 0; brightness < max_brightness; brightness++)
    {
      strip.setBrightness(max_brightness - brightness);
      strip.setPixelColor(0, 255, 255, 255);
      strip.setPixelColor(1, 255, 255, 255);
      strip.setPixelColor(2, 255, 255, 255);
      strip.setPixelColor(3, 255, 255, 255);
      strip.show();
      delay(delay_time / max_brightness / loops / 2);
    }
  }
}

void read_mac()
{
  // Get MAC address of the WiFi station interface
  esp_read_mac(baseMac, ESP_MAC_WIFI_STA);
  Serial.print("Station MAC: ");
  for (int i = 0; i < 5; i++)
  {
    Serial.printf("%02X:", baseMac[i]);
  }
  Serial.printf("%02X\n", baseMac[5]);
}

void init_oled()
{
  // SSD1306_SWITCHCAPVCC [=0x02] = generate display voltage from 3.3V internally
  display.begin(0x02, SCREEN_ADDRESS, OLED_RESET);
  display.clearDisplay();
  // Show initial display buffer contents on the screen --
  // the library initializes this with an Adafruit splash screen.
  display.display();
  display.setTextColor(WHITE); // Draw white text

  display.setRotation(2);

  display.setFont(&FreeSans9pt7b);
}

void init_leds()
{
  strip.begin(); // INITIALIZE NeoPixel strip object (REQUIRED)
  strip.show();  // Turn OFF all pixels ASAP
}

void show_thm_logo_oled(void)
{
  display.clearDisplay();

  delay(1000);

  display.drawBitmap(
      (display.width() - LOGO_WIDTH) / 2,
      (display.height() - LOGO_HEIGHT) / 2,
      thm_logo, LOGO_WIDTH, LOGO_HEIGHT, 1);
  display.display();
}

void callBack(char* topic, byte* payload, unsigned int length) {
    char json[length + 1];
    memcpy(json, payload, length);
    json[length] = '\0';

    DynamicJsonDocument doc(256);
    deserializeJson(doc, json);

    JsonArray sequence = doc["sequence"];

    for (JsonVariant v : sequence) {
        const char* color = v.as<const char*>();
        show_color_sequence(color); // Funktion außerhalb definiert
    }
}
void show_color_sequence(const char* color){
    uint8_t max_brightness = 20;
    strip.setBrightness(max_brightness);  // war vorher 'brightness'

    if (strcmp(color, "RED") == 0) {
        strip.setPixelColor(0, strip.Color(255, 0, 0));
    } else if (strcmp(color, "GREEN") == 0) {
        strip.setPixelColor(0, strip.Color(0, 255, 0));
    } else if (strcmp(color, "BLUE") == 0) {
        strip.setPixelColor(0, strip.Color(0, 0, 255));
    } else if (strcmp(color, "YELLOW") == 0) {
        strip.setPixelColor(0, strip.Color(255, 255, 0));
    } else {
        strip.setPixelColor(0, 0); // LED aus
    }

    strip.show();
    delay(800);
    strip.clear();
    strip.show();
    delay(200);
}



void colorsTest(){
  for (int counter = 0; counter <3; counter++) {
    const char* color = text_colors[counter];
    show_color_sequence(color);

  }
}
